#include <Arduino.h>
#include "Display.h"
#include <Adafruit_SSD1306.h>

#define SCREEN_WIDTH 128
#define SCREEN_HEIGHT 32

#define OLED_RESET 4 // Reset pin # (or -1 if sharing Arduino reset pin) // Declaration for an SSD1306 display connected to I2C (SDA, SCL pins)

Adafruit_SSD1306 oledDisplay(SCREEN_WIDTH, SCREEN_HEIGHT, &Wire, OLED_RESET);
unsigned int nextGraphIndex = 0;
unsigned int graph[66];

void Display::initializeDisplay()
{
  if (!oledDisplay.begin(SSD1306_SWITCHCAPVCC, 0x3C))
  { // Address 0x3C for 128x32, SSD1306_SWITCHCAPVCC = generate display voltage from 3.3V internally
    Serial.println(F("SSD1306 allocation failed"));
    for (;;)
      ; // Don't proceed, loop forever
  }

  Display::showSplashScreen();
}

void Display::update(double RPM)
{
  static const unsigned char PROGMEM thumbsUp[] = {0x00, 0x00, 0x00, 0x00, 0x00, 0x00, 0x00, 0x01, 0xc0, 0x00, 0x07, 0xc0, 0x00,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 0x00, 0x00};
  static const unsigned char PROGMEM thumbsDown[] = {0x00, 0x00, 0x00, 0x38, 0x03, 0x80, 0x7e, 0x0f, 0xc0, 0x3f, 0x1f, 0x80, 0x0f,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 0x00, 0x00};

  oledDisplay.clearDisplay();

  oledDisplay.setTextSize(2);
  oledDisplay.setCursor(2, 2);
  oledDisplay.setTextColor(WHITE);
  oledDisplay.println(RPM);

  oledDisplay.setTextSize(1);
  oledDisplay.setCursor(65, 2);
  oledDisplay.println("RPM");

  oledDisplay.drawLine(0, 18, 128, 18, WHITE);
  oledDisplay.drawLine(90, 2, 90, 15, WHITE);

  if ((RPM > 33 && RPM < 34) || (RPM > 44 && RPM < 46))
  {
    oledDisplay.drawBitmap(100, 3, thumbsUp, 19, 13, 1);
  }
  else
  {
    oledDisplay.drawBitmap(100, 3, thumbsDown, 19, 13, 1);
  }

  if (RPM <= 10)
  {
    graph[nextGraphIndex] = 1;
  }
  else if (RPM > 10 && RPM <= 20)
  {
    graph[nextGraphIndex] = 2;
  }
  else if (RPM > 20 && RPM <= 30)
  {
    graph[nextGraphIndex] = 4;
  }
  else if (RPM > 30 && RPM <= 40)
  {
    graph[nextGraphIndex] = 6;
  }
  else if (RPM > 40)
  {
    graph[nextGraphIndex] = 8;
  }

  nextGraphIndex++;
  if (nextGraphIndex > 67)
  {
    nextGraphIndex = 0;
  }

  for (int i = 0; i < 66; i++)
  {
    oledDisplay.drawLine((1 * i) * 2 + 1, 28, (1 * i * 2) + 1, 28 - graph[i], WHITE);
  }

  oledDisplay.display();
}

void Display::showSplashScreen()
{
  static const unsigned char PROGMEM splashScreen[] = {
      0x00, 0x00, 0x00, 0x00, 0x00, 0x00, 0x00, 0x00, 0x00, 0x00, 0x00, 0x00, 0x00, 0x00, 0x00, 0x00,
      0x00, 0x03, 0xbc, 0x00, 0x00, 0x00, 0x00, 0x00, 0x00, 0x00, 0x00, 0x00, 0x00, 0x00, 0x00, 0x00,
      0x00, 0x1d, 0xbd, 0xe0, 0x00, 0x00, 0x00, 0x00, 0x00, 0x00, 0x00, 0x00, 0x00, 0x00, 0x00, 0x00,
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      0x00, 0x00, 0xf8, 0x00, 0x00, 0x00, 0x00, 0x00, 0x00, 0x00, 0x00, 0x00, 0x00, 0x00, 0x00, 0x00};

  oledDisplay.clearDisplay();
  oledDisplay.drawBitmap(0, 0, splashScreen, 128, 32, 1);
  oledDisplay.display();
  delay(5000);

  oledDisplay.clearDisplay();
  Display::update(0.0);
}
