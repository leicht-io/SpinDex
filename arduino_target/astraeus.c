#include <SPI.h>
#include <Wire.h>
#include <Adafruit_GFX.h>
#include <Adafruit_SSD1306.h>
#include <TimerOne.h>

#define SCREEN_WIDTH 128 // OLED display width, in pixels
#define SCREEN_HEIGHT 32 // OLED display height, in pixels

// Declaration for an SSD1306 display connected to I2C (SDA, SCL pins)
#define OLED_RESET     4 // Reset pin # (or -1 if sharing Arduino reset pin)
Adafruit_SSD1306 display(SCREEN_WIDTH, SCREEN_HEIGHT, &Wire, OLED_RESET);

unsigned int nextGraphIndex = 0;

const int IRSensorPin = 2;  // the number of the IR sensor input pin

int inputState;                          // the current state from the input pin
int lastInputState = LOW;        // the previous InputState from the input pin
long lastDebounceTime = 0;   // the last time the output pin was toggled
long debounceDelay = 5;        // the debounce time; increase if the output flickers
long time;
long endTime;
long startTime;
float RPM = 0.0;
float lnTime = 0;


static const unsigned char PROGMEM thumbsUp[] = {
  0x00, 0x00, 0x00, 0x00, 0x00, 0x00, 0x00, 0x01, 0xc0, 0x00, 0x07, 0xc0, 0x00, 0x0f, 0x00, 0x30,
0x3e, 0x00, 0x78, 0x7c, 0x00, 0x3f, 0xf0, 0x00, 0x1f, 0xe0, 0x00, 0x07, 0x80, 0x00, 0x03, 0x00,
0x00, 0x00, 0x00, 0x00, 0x00, 0x00, 0x00
};

static const unsigned char PROGMEM thumbsDown[] = {
0x00, 0x00, 0x00, 0x38, 0x03, 0x80, 0x7e, 0x0f, 0xc0, 0x3f, 0x1f, 0x80, 0x0f, 0xfe, 0x00, 0x07,
0xfc, 0x00, 0x03, 0xf8, 0x00, 0x07, 0xfc, 0x00, 0x0f, 0xfe, 0x00, 0x3f, 0x1f, 0x80, 0x7c, 0x07,
0xc0, 0x38, 0x03, 0x80, 0x00, 0x00, 0x00
};

static const unsigned char PROGMEM logo_bmp[] ={
 0x00, 0x00, 0x00, 0x00, 0x00, 0x00, 0x00, 0x00, 0x00, 0x00, 0x00, 0x00, 0x00, 0x00, 0x00, 0x00,
  0x00, 0x03, 0xbc, 0x00, 0x00, 0x00, 0x00, 0x00, 0x00, 0x00, 0x00, 0x00, 0x00, 0x00, 0x00, 0x00,
  0x00, 0x1d, 0xbd, 0xe0, 0x00, 0x00, 0x00, 0x00, 0x00, 0x00, 0x00, 0x00, 0x00, 0x00, 0x00, 0x00,
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  0x00, 0x00, 0xf8, 0x00, 0x00, 0x00, 0x00, 0x00, 0x00, 0x00, 0x00, 0x00, 0x00, 0x00, 0x00, 0x00
};

unsigned int graph[66];

void setup() {
  Serial.begin(9600);
    initializeDisplay();

  enableInterrupt();
}

void initializeDisplay() {
  if(!display.begin(SSD1306_SWITCHCAPVCC, 0x3C)) { // Address 0x3C for 128x32, SSD1306_SWITCHCAPVCC = generate display voltage from 3.3V internally
    Serial.println(F("SSD1306 allocation failed"));
    for(;;); // Don't proceed, loop forever
  }

  display.clearDisplay();
  display.drawBitmap(0, 0, logo_bmp, 128, 32, 1);
  display.display();
  delay(5000);

  display.clearDisplay();
  updateScreen(0.0);
}

void enableInterrupt() {
  pinMode(IRSensorPin, INPUT);

    endTime = 0;
    Timer1.initialize(1000000);  // Set the timer to 60 rpm, 1,000,000 microseconds (1 second)
    Timer1.attachInterrupt(timerIsr);  // Attach the service routine here
}

void loop() {
    time = millis();
  int currentSwitchState = digitalRead(IRSensorPin);

  if (currentSwitchState != lastInputState) {
    lastDebounceTime = millis();
  }

  if ((millis() - lastDebounceTime) > debounceDelay) {
    if (currentSwitchState != inputState) {
      inputState = currentSwitchState;
      if (inputState == LOW) {
        calculateRPM(); // Real RPM from sensor
      }
    }
  }
  lastInputState = currentSwitchState;
}

void calculateRPM() {
  startTime = lastDebounceTime;
  lnTime = startTime - endTime;
  RPM = (60000 / (lnTime)) / 24.0; // 24 dark bars on BG4002
  endTime = startTime;
}


void timerIsr()
{
  time = millis() / 1000;
  Serial.println(RPM);
  updateScreen(RPM);
  delay(500);

  RPM = 0.0;
}


String zeroPad(double RPM) {
 String RPMToReturn = String(RPM);

 if(RPMToReturn.length() == 4) {
  int indexOfSeperator = RPMToReturn.indexOf(".");
  if(indexOfSeperator == 1) {
    return "0" + RPMToReturn;
  } else if(indexOfSeperator == 2) {
    return RPMToReturn + "0";
  }
 }

return RPMToReturn;
}

void updateScreen(double RPM) {
  display.clearDisplay();

  display.setTextSize(2); // Draw 2X-scale text
  display.setTextColor(WHITE);
  display.setCursor(2, 2);
  display.println(zeroPad(RPM));
 
  display.setTextSize(1);
  display.setCursor(65, 2);
  display.println("RPM");

  display.drawLine(0 , 18, 128, 18, WHITE);
  display.drawLine(90 , 2, 90, 15, WHITE);

  if(RPM > 33 && RPM < 33.5) {
    display.drawBitmap(100,3,thumbsUp, 19, 13, 1);    
  } else {
    display.drawBitmap(100,3,thumbsDown, 19, 13, 1);    
  }
 
  if(RPM <= 10) {
   graph[nextGraphIndex] = 1;
  } else if(RPM > 10  && RPM <= 20) {
    graph[nextGraphIndex] = 2;
  } else if(RPM > 20 && RPM <= 30){
    graph[nextGraphIndex] = 4;
  } else if(RPM > 30 && RPM <= 40) {
    graph[nextGraphIndex] = 6;
  }else if(RPM > 40) {
    graph[nextGraphIndex] = 8;
  }

  nextGraphIndex++;
  if(nextGraphIndex > 67) {
    nextGraphIndex = 0;
  }

  for(int i = 0; i < 66; i++) {
    display.drawLine((1 * i) * 2 + 1, 28, (1 * i * 2) + 1,  28 - graph[i], WHITE);
  }  

  display.display();
}
